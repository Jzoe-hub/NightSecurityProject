/**********************************************************************
 * 文件名称： dht11.c
 * 功能描述： DHT11 数字温湿度传感器驱动（单总线协议）
 * 来    源： 百问网 韦东山 (DShanMCU-F103), SPL→HAL 移植, 协议逻辑保留
 * 硬件连接： DATA → PA12 (开漏输出 + 外部上拉)
 * 说    明： 1. GPIO 配置 → CubeMX 已设为开漏输出, 不初始化硬件
 *           2. 时序依赖 µs 级延时, 使用 __NOP 忙等
 *           3. 读取期间关闭中断可提高成功率, 本版本不关中断
 ***********************************************************************/
#include "dht11.h"
#include "stm32f1xx_hal.h"

/* ---- DHT11 引脚定义 ---- */
#define DHT11_PORT          GPIOA
#define DHT11_PIN           GPIO_PIN_12

/* ---- µs 级忙等延时 (72MHz, 粗略校准约 8 NOP/µs) ---- */
static void udelay(uint32_t us)
{
	uint32_t count = us * 8;
	while (count--) { __NOP(); }
}

/* ===================== GPIO 底层操作 ===================== */

/**********************************************************************
 * 函数名称： DHT11_PinCfgAsOutput
 * 功能描述： 空函数 — CubeMX 已把 DATA 引脚配为开漏输出
 ***********************************************************************/
static void DHT11_PinCfgAsOutput(void)
{
	/* CubeMX 已配置 PA12 为开漏输出 */
}

/**********************************************************************
 * 函数名称： DHT11_PinCfgAsInput
 * 功能描述： 开漏模式下写 1 释放总线, 即可读取引脚电平
 ***********************************************************************/
static void DHT11_PinCfgAsInput(void)
{
	HAL_GPIO_WritePin(DHT11_PORT, DHT11_PIN, GPIO_PIN_SET);
}

/**********************************************************************
 * 函数名称： DHT11_PinSet
 * 功能描述： 设置 DATA 引脚输出电平
 * 输入参数： val — 0=低电平, 非 0=高电平
 ***********************************************************************/
static void DHT11_PinSet(int val)
{
	HAL_GPIO_WritePin(DHT11_PORT, DHT11_PIN,
			val ? GPIO_PIN_SET : GPIO_PIN_RESET);
}

/**********************************************************************
 * 函数名称： DHT11_PinRead
 * 功能描述： 读取 DATA 引脚电平
 * 返 回 值： 0=低电平, 1=高电平
 ***********************************************************************/
static int DHT11_PinRead(void)
{
	return (HAL_GPIO_ReadPin(DHT11_PORT, DHT11_PIN) == GPIO_PIN_SET) ? 1 : 0;
}

/* ===================== DHT11 协议层 ===================== */

/**********************************************************************
 * 函数名称： DHT11_Start
 * 功能描述： 发送起始信号 — 拉低总线 ≥18ms 后释放
 ***********************************************************************/
static void DHT11_Start(void)
{
	DHT11_PinSet(0);
	HAL_Delay(20);
	DHT11_PinCfgAsInput();
}

/**********************************************************************
 * 函数名称： DHT11_Wait_Ack
 * 功能描述： 等待 DHT11 应答 — 延迟 60µs 后检测总线电平
 * 返 回 值： 0=有应答(DHT11 拉低总线), 1=无应答
 ***********************************************************************/
static int DHT11_Wait_Ack(void)
{
	udelay(60);
	return DHT11_PinRead();
}

/**********************************************************************
 * 函数名称： DHT11_WaitFor_Val
 * 功能描述： 在指定时间内等待总线变为目标电平
 * 输入参数： val — 目标电平 (0 或 1)
 *            timeout_us — 超时时间 (µs)
 * 返 回 值： 0=成功, -1=超时失败
 ***********************************************************************/
static int DHT11_WaitFor_Val(int val, int timeout_us)
{
	while (timeout_us--)
	{
		if (DHT11_PinRead() == val)
			return 0;
		udelay(1);
	}
	return -1;
}

/**********************************************************************
 * 函数名称： DHT11_ReadByte
 * 功能描述： 从 DHT11 读取 1 字节数据
 * 返 回 值： 读取到的字节, -1 表示超时
 * 说    明： 每位数据 — 50µs 低脉冲 + 高脉冲
 *           bit0=26~28µs 高脉冲, bit1=70µs 高脉冲
 *           上升沿后延时 40µs 采样 — bit0 已变低, bit1 仍为高
 ***********************************************************************/
static int DHT11_ReadByte(void)
{
	int data = 0;

	for (int i = 0; i < 8; i++)
	{
		if (DHT11_WaitFor_Val(1, 1000))        // 等待上升沿
			return -1;

		udelay(40);                            // 40µs 后采样

		data <<= 1;
		if (DHT11_PinRead() == 1)
			data |= 1;

		if (DHT11_WaitFor_Val(0, 1000))        // 等待下降沿
			return -1;
	}
	return data;
}

/* ===================== 公开接口 ===================== */

/**********************************************************************
 * 函数名称： DHT11_Init
 * 功能描述： DHT11 初始化 — DATA 引脚置高, 进入空闲等待状态
 ***********************************************************************/
void DHT11_Init(void)
{
	DHT11_PinCfgAsOutput();
	DHT11_PinSet(1);
}

/**********************************************************************
 * 函数名称： DHT11_Read
 * 功能描述： 执行一次完整的 DHT11 温湿度读取，协议时序：
 *           1. 主机拉低 ≥18ms → 释放总线
 *           2. DHT11 应答 (拉低 80µs + 拉高 80µs)
 *           3. DHT11 发送 40bit 数据 (5 字节, 末字节=前 4 字节之和)
 *           4. 校验通过 → 提取温湿度
 * 输出参数： hum  — 湿度值 (%RH, 整数)
 *            temp — 温度值 (℃, 整数)
 * 返 回 值： 0 = 成功, -1 = 失败 (无应答 / 校验错 / 超时)
 * 说    明： 1. 读取周期至少 2 秒
 *           2. DHT11 小数部分固定为 0, 精度 1℃/1%RH
 ***********************************************************************/
int DHT11_Read(int *hum, int *temp)
{
	unsigned char hum_m, hum_n;
	unsigned char temp_m, temp_n;
	unsigned char check;

	DHT11_Start();

	if (0 != DHT11_Wait_Ack())
		return -1;

	if (0 != DHT11_WaitFor_Val(1, 1000))
		return -1;

	if (0 != DHT11_WaitFor_Val(0, 1000))
		return -1;

	hum_m  = DHT11_ReadByte();
	hum_n  = DHT11_ReadByte();
	temp_m = DHT11_ReadByte();
	temp_n = DHT11_ReadByte();
	check  = DHT11_ReadByte();

	DHT11_PinCfgAsOutput();
	DHT11_PinSet(1);

	if (hum_m + hum_n + temp_m + temp_n == check)
	{
		*hum  = hum_m;
		*temp = temp_m;
		return 0;
	}
	return -1;
}
